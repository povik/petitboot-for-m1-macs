## configs/apple_m1_petitboot_defconfig
```kconfig
BR2_aarch64=y
BR2_CCACHE=y
BR2_CCACHE_DIR=".buildroot-ccache-arm64"
BR2_TOOLCHAIN_BUILDROOT_WCHAR=y
BR2_ROOTFS_MERGED_USR=y
BR2_TARGET_GENERIC_ISSUE="Welcome to Petitboot"
BR2_ROOTFS_DEVICE_CREATION_DYNAMIC_EUDEV=y
BR2_ROOTFS_OVERLAY="package/petitboot/fs-overlay"
BR2_LINUX_KERNEL=y
BR2_LINUX_KERNEL_INTREE_SOURCE=y
BR2_PACKAGE_BUSYBOX_SHOW_OTHERS=y
BR2_PACKAGE_KEXEC=y
BR2_PACKAGE_KEXEC_ZLIB=y
BR2_PACKAGE_STRACE=y
BR2_PACKAGE_DTC=y
BR2_PACKAGE_DTC_PROGRAMS=y
BR2_PACKAGE_NCURSES=y
BR2_PACKAGE_NCURSES_WCHAR=y
BR2_PACKAGE_DROPBEAR=y
BR2_PACKAGE_ETHTOOL=y
BR2_PACKAGE_NETCAT=y
BR2_PACKAGE_NET_TOOLS=y
BR2_PACKAGE_RSYNC=y
BR2_PACKAGE_PETITBOOT=y
BR2_TARGET_ROOTFS_CPIO_XZ=y
BR2_TARGET_ROOTFS_INITRAMFS=y
BR2_LINUX_KERNEL_USE_CUSTOM_CONFIG=y
BR2_LINUX_KERNEL_CUSTOM_CONFIG_FILE="board/apple-m1/linux-config"
BR2_TARGET_GENERIC_ROOT_PASSWD="r"
BR2_PACKAGE_PETITBOOT_DEBUG=y
BR2_PACKAGE_UTIL_LINUX_BINARIES=y
BR2_PACKAGE_UTIL_LINUX_AGETTY=y
BR2_PACKAGE_MDADM=y
BR2_LINUX_KERNEL_IMAGEGZ=y
BR2_PACKAGE_ELFUTILS=y
BR2_PACKAGE_PETITBOOT_M1_HOOK=y
```

## package/petitboot-m1-hook/Config.in
```kconfig
config BR2_PACKAGE_PETITBOOT_M1_HOOK
	bool "petitboot devicetree hook on Apple M1"
	help
	  Enable hook for Petitboot which fills runtime information into the devicetree blobs
	  associated with boot menu options.
```
